## components/lvgl/Kconfig
```kconfig
config LVGL
    bool "Build LVGL component"
    default n
    help
      Build LVGL 9.5 with Linux DRM, evdev and the widgets demo.
```

## components/media_engine/Kconfig
```kconfig
config MEDIA_ENGINE
    bool "Build media_engine component"
    default n
    select MEDIA_PIPELINE
```

## components/mipk_audio/Kconfig
```kconfig
config MIPK_AUDIO
    bool "Build mipk_audio (microphone audio into a mipk pipeline)"
    default n
    select MIPK_RUNTIME
    select MEDIA_ENGINE
    help
      Glue between media_engine and mipk_runtime for audio models: opens
      a model package and feeds captured PCM into its pipeline.
```

## components/mipk_runtime/Kconfig
```kconfig
config MIPK_RUNTIME
    bool "Build the mipk model inference runtime"
    default n
    help
      Model inference runtime, built from a checkout of the mipk
      repository given by MIPK_PATH. Pick the modules the application's model
      packages need; a package naming a module that is not built fails to
      open with a message naming it.

if MIPK_RUNTIME

config MIPK_MODEL_YOLO
    bool "YOLO detection decoder"
    default n

config MIPK_MODEL_YOLO_POSE
    bool "YOLO pose decoder"
    default n

config MIPK_MODEL_CLASSIFICATION
    bool "Classification decoder"
    default n

config MIPK_MODEL_KEYPOINTS
    bool "Keypoint decoder"
    default n

config MIPK_MODEL_MICROWAKEWORD
    bool "MicroWakeWord decoder"
    default n
    help
      Also builds the audio operators it needs (tfmicrofrontend,
      wake_word_trigger, with the TF MicroFrontend feature extractor).

menu "Modules from mipk_extra_module"
    # The mipk_extra_module repository is found next to the mipk checkout or
    # through MIPK_EXTRA_MODULE_PATH. Each module here is built and
    # registered exactly like a built-in one.

config MIPK_EXTRA_FASTESTDET
    bool "FastestDet decoder (fastestdet)"
    default n

config MIPK_EXTRA_MEDIAPIPE_HAND
    bool "MediaPipe palm detection + hand landmarks (mediapipe_hand)"
    default n

config MIPK_EXTRA_MODULES
    string "Other module directory names (space separated)"
    default ""
    help
      Modules in mipk_extra_module that have no switch above, by directory
      name, for example "my_decoder other_decoder".

endmenu

endif
```

## components/mipk_video/Kconfig
```kconfig
config MIPK_VIDEO
    bool "Build mipk_video (camera frames into a mipk pipeline)"
    default n
    select MIPK_RUNTIME
    select MEDIA_ENGINE
    help
      Glue between media_engine and mipk_runtime for vision models: opens
      a model package, feeds camera frames into its pipeline and converts
      the results.
```

## components/opencv/Kconfig
```kconfig
config OPENCV
    bool "Build with OpenCV (static, compiled from source)"
    default n
    help
      OpenCV 4.13 as static libraries linked into the application. They
      are compiled from the source archive of the component the first
      time a compiler needs them. The board image does not need to
      provide OpenCV.

if OPENCV

config OPENCV_MODULES
    string "OpenCV modules"
    default "core,imgproc,imgcodecs"
    help
      Comma separated list of the OpenCV modules to build; their
      dependencies are added automatically. The shipped source archive
      contains core, imgproc and imgcodecs (JPEG, PNG); for others point
      OPENCV_SOURCE_ARCHIVE at a complete OpenCV source archive.

endif
```

## examples/helloworld/Kconfig
```kconfig
config HELLOWORLD_MESSAGE
    string "Message printed by the example"
    default "configured by hifw"
```

## examples/helloworld/components/hi_log/Kconfig
```kconfig
menu "Logging"

choice HI_LOG_LEVEL
    prompt "Log level"
    default HI_LOG_LEVEL_INFO
    help
        Select the highest log level enabled in the application.

config HI_LOG_LEVEL_NONE
    bool "None"

config HI_LOG_LEVEL_ERROR
    bool "Error"

config HI_LOG_LEVEL_WARN
    bool "Warning"

config HI_LOG_LEVEL_INFO
    bool "Info"

config HI_LOG_LEVEL_DEBUG
    bool "Debug"

endchoice

endmenu
```

## examples/lvgl_widgets/Kconfig
```kconfig
config LVGL_WIDGETS_DRM_DEVICE
    string "DRM display device"
    default "/dev/dri/card0"
    help
      DRM card opened by the LVGL Linux DRM backend.

config LVGL_WIDGETS_INPUT_DEVICE
    string "Touch input device"
    default "/dev/input/event0"
    help
      Linux evdev device used as the LVGL pointer input.

config LVGL_WIDGETS_SERIAL_DEVICE
    string "Encoder terminal device"
    default "/dev/tty"
    help
      Current controlling terminal used for encoder key input when the touch
      input device is unavailable.
```

## examples/lvgl_widgets/sdkconfig.defaults
```kconfig
CONFIG_LVGL=y
CONFIG_LVGL_WIDGETS_DRM_DEVICE="/dev/dri/card0"
CONFIG_LVGL_WIDGETS_INPUT_DEVICE="/dev/input/event0"
CONFIG_LVGL_WIDGETS_SERIAL_DEVICE="/dev/tty"
```
